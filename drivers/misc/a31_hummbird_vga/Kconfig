## drivers/misc/a31_hummbird_vga/Kconfig
```kconfig
#
# SN7325 chip drivers configuration
#
config  SW_VGA_MODULE
	tristate "a31_humbvga  support"
	
	help
	  If you say yes here you get support for sn7325
```
